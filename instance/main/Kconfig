## instance/main/Kconfig
```kconfig
menu "Application Configuration"
config FIRMWARE_UPGRADE_URL
    string "firmware upgrade url endpoint"
    default "https://192.168.0.3:8070/hello_world.bin"
    help
        URL of server which hosts the firmware
        image.

config USE_CERT_BUNDLE
    bool "Enable certificate bundle"
    default y
    depends on MBEDTLS_CERTIFICATE_BUNDLE
    help
        Enable trusted root certificate bundle. This approach allows to have
        OTA updates functional with any public server without requirement
        to explicitly add its server certificate.

config FIRMWARE_UPGRADE_URL_FROM_STDIN
    bool
    default y if FIRMWARE_UPGRADE_URL = "FROM_STDIN"

config SKIP_COMMON_NAME_CHECK
    bool "Skip server certificate CN fieldcheck"
    default n
    help
        This allows you to skip the validation of OTA server certificate CN field.

config FIRMWARE_UPGRADE_BIND_IF
    bool "Support firmware upgrade bind specified interface"
    default n
    help
        This allows you to bind specified interface in OTA example.

choice FIRMWARE_UPGRADE_BIND_IF_TYPE
    prompt "Choose OTA data bind interface"
    default FIRMWARE_UPGRADE_BIND_IF_STA
    depends on FIRMWARE_UPGRADE_BIND_IF
    help
        Select which interface type of OTA data go through.

    config FIRMWARE_UPGRADE_BIND_IF_STA
        bool "Bind wifi station interface"
        depends on CONNECT_WIFI
        help
            Select wifi station interface to pass the OTA data.

    config FIRMWARE_UPGRADE_BIND_IF_ETH
        bool "Bind ethernet interface"
        depends on CONNECT_ETHERNET
        help
            Select ethernet interface to pass the OTA data.
endchoice

config CONNECT_WIFI
    bool "connect using WiFi interface"
    depends on !IDF_TARGET_LINUX && (SOC_WIFI_SUPPORTED || ESP_WIFI_REMOTE_ENABLED || ESP_HOST_WIFI_ENABLED)
    default y if SOC_WIFI_SUPPORTED
    help
        Protocol examples can use Wi-Fi, Ethernet and/or Thread to connect to the network.
        Choose this option to connect with WiFi

if CONNECT_WIFI
config WIFI_SSID_PWD_FROM_STDIN
    bool "Get ssid and password from stdin"
    default n
    help
        Give the WiFi SSID and password from stdin.

config PROVIDE_WIFI_CONSOLE_CMD
    depends on !WIFI_SSID_PWD_FROM_STDIN
    bool "Provide wifi connect commands"
    default y
    help
        Provide wifi connect commands for esp_console.
        Please use `example_register_wifi_connect_commands` to register them.

config WIFI_SSID
    depends on !WIFI_SSID_PWD_FROM_STDIN
    string "WiFi SSID"
    default "myssid"
    help
        SSID (network name) for the example to connect to.

config WIFI_PASSWORD
    depends on !WIFI_SSID_PWD_FROM_STDIN
    string "WiFi Password"
    default "mypassword"
    help
        WiFi password (WPA or WPA2) for the example to use.
        Can be left blank if the network has no security set.

config WIFI_CONN_MAX_RETRY
    int "Maximum retry"
    default 6
    help
        Set the Maximum retry to avoid station reconnecting to the AP unlimited,
        in case the AP is really inexistent.

choice WIFI_SCAN_METHOD
    prompt "WiFi Scan Method"
    default WIFI_SCAN_METHOD_ALL_CHANNEL
    help
        WiFi scan method:

        If "Fast" is selected, scan will end after find SSID match AP.

        If "All Channel" is selected, scan will end after scan all the channel.

    config WIFI_SCAN_METHOD_FAST
        bool "Fast"
    config WIFI_SCAN_METHOD_ALL_CHANNEL
        bool "All Channel"
endchoice
endif
endmenu
```
